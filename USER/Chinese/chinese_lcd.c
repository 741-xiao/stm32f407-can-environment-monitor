#include "lcd.h"
#include "chinese_lcd.h"
#include "app_glyphs.h"

extern u16 BRUSH_COLOR;
extern u16 BACK_COLOR;

/* UTF-8 labels use a small embedded subset; no external font ROM is needed. */
void LCD_TextUTF8(u16 x, u16 y, const char *text)
{
    const unsigned char *p = (const unsigned char *)text;
    unsigned int i;
    u16 code;
    u8 row, col;
    while (*p && y + 24U <= lcd_height) {
        if (*p < 128U) {
            if (x + 8U > lcd_width) break;
            LCD_DisplayChar(x, (u16)(y + 4U), *p++, 16U);
            x += 8U;
        } else if ((*p & 0xF0U) == 0xE0U && p[1] && p[2] &&
                   (p[1] & 0xC0U) == 0x80U && (p[2] & 0xC0U) == 0x80U) {
            if (x + 24U > lcd_width) break;
            code = (u16)(((p[0] & 15U) << 12) | ((p[1] & 63U) << 6) | (p[2] & 63U));
            for (i = 0U; i < sizeof(app_glyphs) / sizeof(app_glyphs[0]); i++)
                if (app_glyphs[i].code == code) break;
            if (i < sizeof(app_glyphs) / sizeof(app_glyphs[0])) {
                for (row = 0U; row < 24U; row++)
                    for (col = 0U; col < 24U; col++)
                        LCD_Color_DrawPoint((u16)(x + col), (u16)(y + row),
                            app_glyphs[i].rows[row] & (0x800000UL >> col) ? BRUSH_COLOR : BACK_COLOR);
            } else LCD_DisplayChar(x, (u16)(y + 4U), '?', 16U);
            p += 3;
            x += 24U;
        } else { p++; }
    }
}

/* 24x24 glyphs: temperature, humidity, labels, name, update counter and status. */
static const u32 lcd_hanzi[][24] =
{
  {0x000000,0x100000,0x38FFF0,0x0EC030,0x04C030,0x007FF0,0x007FF0,0x704030,0x38C030,0x08FFF0,0x00FFF0,0x000000,0x000000,0x0DFFF8,0x098998,0x198998,0x198998,0x118998,0x318998,0x318998,0x77FFFE,0x07FFFE,0x000000,0x000000},
  {0x000000,0x001C00,0x000C00,0x1FFFF8,0x1FFFF8,0x1860C0,0x1860C0,0x1860C0,0x1BFFF8,0x1860C0,0x1860C0,0x187FC0,0x187FC0,0x180000,0x19FFE0,0x1860C0,0x1830C0,0x301980,0x301F00,0x300F00,0x60FBF8,0x27C07C,0x000000,0x000000},
  {0x107FF8,0x387FF8,0x1C4018,0x064018,0x047FF8,0x007FF8,0x004018,0x704018,0x387FF8,0x087FF8,0x000000,0x000CC0,0x098CC6,0x0CCCC4,0x08CCCC,0x18CCD8,0x186CD8,0x304CD0,0x300CC0,0x61FFFE,0x21FFFE,0x000000,0x000000,0x000000},
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  {0x180000,0x1C7FF0,0x0E6010,0x066010,0x006010,0x007FF0,0x407FF0,0x7C0000,0x0C0000,0x0CFFFC,0x0C0300,0x0C0200,0x0C0200,0x0CFFFE,0x0C0700,0x0D0D80,0x0F0D80,0x0E18C0,0x1C3070,0x08E03E,0x01C00C,0x000000,0x000000,0x000000}
};

void LCD_DisplayChinese(u16 x, u16 y, u8 index)
{
    u8 row;
    u8 col;
    u32 row_data;

    if (index >= (sizeof(lcd_hanzi) / sizeof(lcd_hanzi[0])))
    {
        return;
    }
    for (row = 0U; row < 26U; row++)
    {
        for (col = 0U; col < 26U; col++)
        {
            if ((row > 0U) && (row < 25U) && (col > 0U) && (col < 25U))
            {
                row_data = lcd_hanzi[index][row - 1U];
                if ((row_data & ((u32)0x800000U >> (col - 1U))) != 0U)
                {
                    LCD_Color_DrawPoint((u16)(x + col), (u16)(y + row), BRUSH_COLOR);
                }
                else
                {
                    LCD_Color_DrawPoint((u16)(x + col), (u16)(y + row), BACK_COLOR);
                }
            }
            else
            {
                LCD_Color_DrawPoint((u16)(x + col), (u16)(y + row), BACK_COLOR);
            }
        }
    }
}
