#include "ssd1306.h"
#include "app_config.h"
#include "sht30.h"
#include <stdio.h>
#include <string.h>

static uint8_t framebuffer[SSD1306_WIDTH * SSD1306_HEIGHT / 8U];
static uint8_t display_on;

static const uint8_t font[][5] = {
    {0x00,0x00,0x00,0x00,0x00}, {0x00,0x00,0x5F,0x00,0x00},
    {0x00,0x07,0x00,0x07,0x00}, {0x14,0x7F,0x14,0x7F,0x14},
    {0x24,0x2A,0x7F,0x2A,0x12}, {0x23,0x13,0x08,0x64,0x62},
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    {0x08,0x04,0x08,0x10,0x08}
};

static HAL_StatusTypeDef Command(uint8_t command)
{
    uint8_t data[2] = {0x00U, command};
    return HAL_I2C_Master_Transmit(&hi2c1, SSD1306_ADDRESS, data, 2U,
                                   APP_I2C_LOCK_TIMEOUT_MS);
}

static HAL_StatusTypeDef CommandList(const uint8_t *commands, uint16_t count)
{
    uint8_t data[64];
    uint16_t index;
    if (count + 1U > sizeof(data)) return HAL_ERROR;
    data[0] = 0x00U;
    for (index = 0U; index < count; index++) data[index + 1U] = commands[index];
    return HAL_I2C_Master_Transmit(&hi2c1, SSD1306_ADDRESS, data, count + 1U,
                                   APP_I2C_LOCK_TIMEOUT_MS);
}

HAL_StatusTypeDef SSD1306_Init(void)
{
    static const uint8_t setup[] = {
        0xAE,0x20,0x00,0xB0,0xC8,0x00,0x10,0x40,0x81,0x7F,0xA1,0xA6,
        0xA8,0x3F,0xA4,0xD3,0x00,0xD5,0x80,0xD9,0xF1,0xDA,0x12,
        0xDB,0x40,0x8D,0x14,0xAF
    };
    HAL_StatusTypeDef status;
    if (!SHT30_Lock(APP_I2C_LOCK_TIMEOUT_MS)) return HAL_BUSY;
    status = CommandList(setup, sizeof(setup));
    SHT30_Unlock();
    display_on = status == HAL_OK;
    SSD1306_Clear();
    if (display_on) SSD1306_Flush();
    return status;
}

void SSD1306_DisplayOn(void)
{
    if (display_on || !SHT30_Lock(APP_I2C_LOCK_TIMEOUT_MS)) return;
    if (Command(0xAFU) == HAL_OK) display_on = 1U;
    SHT30_Unlock();
}

void SSD1306_DisplayOff(void)
{
    if (!SHT30_Lock(APP_I2C_LOCK_TIMEOUT_MS)) return;
    (void)Command(0xAEU);
    display_on = 0U;
    SHT30_Unlock();
}

void SSD1306_Clear(void)
{
    memset(framebuffer, 0, sizeof(framebuffer));
}

void SSD1306_Flush(void)
{
    uint8_t page;
    uint8_t data[SSD1306_WIDTH + 1U];
    if (!display_on || !SHT30_Lock(APP_I2C_LOCK_TIMEOUT_MS)) return;
    for (page = 0U; page < SSD1306_HEIGHT / 8U; page++) {
        (void)Command((uint8_t)(0xB0U | page));
        (void)Command(0x00U);
        (void)Command(0x10U);
        data[0] = 0x40U;
        memcpy(&data[1], &framebuffer[page * SSD1306_WIDTH], SSD1306_WIDTH);
        (void)HAL_I2C_Master_Transmit(&hi2c1, SSD1306_ADDRESS, data,
                                      sizeof(data), APP_I2C_LOCK_TIMEOUT_MS);
    }
    SHT30_Unlock();
}

static void Glyph(uint8_t x, uint8_t page, char character)
{
    uint8_t index, column, bits, bit;
    if (page >= 8U || x >= SSD1306_WIDTH) return;
    if (character < 32 || character > 127) character = '?';
    index = (uint8_t)(character - 32);
    for (column = 0U; column < 5U && x + column < SSD1306_WIDTH; column++) {
        bits = font[index][column];
        for (bit = 0U; bit < 7U; bit++) {
            if (bits & (1U << bit)) framebuffer[page * SSD1306_WIDTH + x + column] |= (uint8_t)(1U << bit);
        }
    }
}

void SSD1306_Text(uint8_t x, uint8_t page, const char *text)
{
    while (*text && x + 5U < SSD1306_WIDTH) {
        Glyph(x, page, *text++);
        x = (uint8_t)(x + 6U);
    }
}

void SSD1306_Value(uint8_t x, uint8_t page, int32_t value, uint8_t decimals, const char *suffix)
{
    char text[20];
    static const char no_suffix[] = {0};
    uint32_t absolute = value < 0 ? (uint32_t)(-value) : (uint32_t)value;
    const char *unit = suffix ? suffix : no_suffix;
    if (decimals == 1U) {
        (void)snprintf(text, sizeof(text), "%s%lu.%lu%s", value < 0 ? "-" : "",
                       (unsigned long)(absolute / 10U), (unsigned long)(absolute % 10U), unit);
    } else if (decimals == 2U) {
        (void)snprintf(text, sizeof(text), "%s%lu.%02lu%s", value < 0 ? "-" : "",
                       (unsigned long)(absolute / 100U), (unsigned long)(absolute % 100U), unit);
    } else {
        (void)snprintf(text, sizeof(text), "%ld%s", (long)value, unit);
    }
    SSD1306_Text(x, page, text);
}
